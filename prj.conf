## CMakeLists.txt
```
#
# Copyright (c) 2018 Nordic Semiconductor
#
# SPDX-License-Identifier: LicenseRef-BSD-5-Clause-Nordic
#

cmake_minimum_required(VERSION 3.8.2)

# This sample runs as a non-secure application on nRF91. Therefore, it
# requires the secure_partition_manager that prepares the required
# peripherals to be available for the application.
#
# Configure the SPM image to enable the peripherals that this sample
# needs.
set(spm_CONF_FILE
  prj.conf
  ${CMAKE_CURRENT_LIST_DIR}/child_secure_partition_manager.conf
  )

find_package(Zephyr REQUIRED HINTS $ENV{ZEPHYR_BASE})
project(beacon_gateway_mqtt)

# NORDIC SDK APP START
target_sources(app PRIVATE src/main.c)
# NORDIC SDK APP END
zephyr_include_directories(src)

include_directories(src/orientation_detector)
target_sources(app PRIVATE src/aggregator.c)
target_sources(app PRIVATE src/alarm.c)
target_sources(app PRIVATE src/ble.c)
```

## Kconfig
```
#
# Copyright (c) 2018 Nordic Semiconductor ASA
#
# SPDX-License-Identifier: LicenseRef-BSD-5-Clause-Nordic
#

menu "MQTT simple sample"
config MQTT_PUB_TOPIC
	string "MQTT publish topic"
	default "my/publish/topic"

config MQTT_SUB_TOPIC
	string "MQTT subscribe topic"
	default "my/subscribe/topic"

config MQTT_CLIENT_ID
	string "MQTT Client ID"
	default "my-client-id"

config MQTT_BROKER_HOSTNAME
	string "MQTT broker hostname"
	default "mqtt.eclipse.org"

config MQTT_CLIENT_USERNAME
	string "MQTT client username"
	default "NULL"

config MQTT_CLIENT_PASSWORD
	string "MQTT client password"
	default "NULL"

config MQTT_BROKER_PORT
	int "MQTT broker port"
	default 1883

config MQTT_MESSAGE_BUFFER_SIZE
	int "MQTT message buffer size"
	default 128

config MQTT_PAYLOAD_BUFFER_SIZE
	int "MQTT payload buffer size"
	default 128

endmenu

menu "LTE BLE gateway sample"

choice
	prompt "GPS device"
	default GPS_USE_SIM
	help
		Select from which device GPS data will be fetched.

config GPS_USE_SIM
	bool "Use GPS simulator"
	select GPS_SIM
	select GPS_SIM_TRIGGER
	help
		Use simulated GPS data.

config GPS_USE_NRF9160
	bool "User provided GPS device"
	help
		Provide a GPS device that location data will be fetched from and
		sent to nRF Cloud

endchoice

config GPS_DEV_NAME
	string
	default GPS_SIM_DEV_NAME if GPS_USE_SIM
	default "NRF9160_GPS" if GPS_USE_NRF9160

config GPS_SEARCH_INTERVAL
	int "Interval for starting GPS search"
	default 240

config GPS_SEARCH_TIMEOUT
	int "Timeout for GPS search"
	default 120
	help
	  The GPS will stop acquiring GPS fix when it times out.
	  It will restart the search at the start of the next search interval.

endmenu

menu "Zephyr Kernel"
source "$ZEPHYR_BASE/Kconfig.zephyr"
endmenu
```

## sample.yaml
```
sample:
  name: beacon_gateway_mqtt
tests:
  samples.nrf9160.mqtt_simple:
    build_only: true
    build_on_all: true
    platform_whitelist: nrf9160dk_nrf9160ns
    tags: ci_build
```

## prj.conf
```kconfig
# General config
CONFIG_NEWLIB_LIBC=y
CONFIG_ASSERT=y
CONFIG_REBOOT=y

# Networking
CONFIG_NETWORKING=y
CONFIG_NET_NATIVE=n
CONFIG_NET_SOCKETS_OFFLOAD=y
CONFIG_NET_SOCKETS=y
CONFIG_NET_SOCKETS_POSIX_NAMES=y

# LTE link control
CONFIG_LTE_LINK_CONTROL=y
CONFIG_LTE_AUTO_INIT_AND_CONNECT=n

# Enable Bluetooth stack and libraries
CONFIG_BT=y
CONFIG_BT_H4=y
CONFIG_BT_WAIT_NOP=y
CONFIG_BT_CENTRAL=y
CONFIG_BT_GATT_CLIENT=y
CONFIG_BT_GATT_DM=y
CONFIG_BT_SCAN=y
CONFIG_BT_SCAN_FILTER_ENABLE=y
CONFIG_BT_SCAN_UUID_CNT=1

# BSD library
CONFIG_BSD_LIBRARY=y

# GPS
CONFIG_GPS_USE_SIM=y

# For demo purposes, we acquire fix often
CONFIG_GPS_SEARCH_INTERVAL=30
CONFIG_GPS_SEARCH_TIMEOUT=15

# Library for buttons and LEDs
CONFIG_DK_LIBRARY=y
CONFIG_DK_LIBRARY_INVERT_LEDS=n

# AT Host
CONFIG_UART_INTERRUPT_DRIVEN=y
CONFIG_AT_HOST_LIBRARY=y

# MQTT
CONFIG_MQTT_LIB=y
CONFIG_MQTT_LIB_TLS=n

# Appliaction
CONFIG_MQTT_PUB_TOPIC="devices"
CONFIG_MQTT_SUB_TOPIC="devices"
CONFIG_MQTT_CLIENT_ID="ble-gateway"
CONFIG_MQTT_BROKER_HOSTNAME="mqtt.elijahjohnston.com"
CONFIG_MQTT_CLIENT_USERNAME="eli"
CONFIG_MQTT_CLIENT_PASSWORD="null"
CONFIG_MQTT_BROKER_PORT=8883


CONFIG_UART_2_NRF_FLOW_CONTROL=y
CONFIG_UART_INTERRUPT_DRIVEN=y

# Heap and stacks
CONFIG_HEAP_MEM_POOL_SIZE=16384
CONFIG_MAIN_STACK_SIZE=8192
```

## src/main.c
```c
/*
 * Copyright (c) 2018 Nordic Semiconductor ASA
 *
 * SPDX-License-Identifier: LicenseRef-BSD-5-Clause-Nordic
 */

#include <zephyr.h>
#include <stdio.h>
#include <drivers/uart.h>
#include <string.h>

#include <zephyr/types.h>
#include <stddef.h>
#include <sys/printk.h>
#include <sys/util.h>

#include <bluetooth/bluetooth.h>
#include <bluetooth/hci.h>

#include <net/mqtt.h>
#include <net/socket.h>
#include <net/tls_credentials.h>
#include <modem/lte_lc.h>

#include <drivers/gps.h>
#include <net/nrf_cloud.h>

#include <dk_buttons_and_leds.h>

#include "ble.h"
#include "alarm.h"
#include "aggregator.h"

#if defined(CONFIG_LWM2M_CARRIER)
#include <lwm2m_carrier.h>
#endif

/* Interval in milliseconds between each time status LEDs are updated. */
#define LEDS_UPDATE_INTERVAL K_MSEC(500)

/* Interval in microseconds between each time LEDs are updated when indicating
 * that an error has occurred.
 */
#define LEDS_ERROR_UPDATE_INTERVAL 250000

#define BUTTON_1 BIT(0)
#define BUTTON_2 BIT(1)
#define SWITCH_1 BIT(2)
#define SWITCH_2 BIT(3)

#define LED_ON(x)			(x)
#define LED_BLINK(x)		((x) << 8)
#define LED_GET_ON(x)		((x) & 0xFF)
#define LED_GET_BLINK(x)	(((x) >> 8) & 0xFF)

enum {
	LEDS_INITIALIZING       = LED_ON(0),
	LEDS_LTE_CONNECTING     = LED_BLINK(DK_LED3_MSK),
	LEDS_LTE_CONNECTED      = LED_ON(DK_LED3_MSK),
	LEDS_CLOUD_CONNECTING   = LED_BLINK(DK_LED4_MSK),
	LEDS_CLOUD_PAIRING_WAIT = LED_BLINK(DK_LED3_MSK | DK_LED4_MSK),
	LEDS_CLOUD_CONNECTED    = LED_ON(DK_LED4_MSK),
	LEDS_ERROR              = LED_ON(DK_ALL_LEDS_MSK)
} display_state;

/* Buffers for MQTT client. */
static u8_t rx_buffer[CONFIG_MQTT_MESSAGE_BUFFER_SIZE];
static u8_t tx_buffer[CONFIG_MQTT_MESSAGE_BUFFER_SIZE];
static u8_t payload_buf[CONFIG_MQTT_PAYLOAD_BUFFER_SIZE];

/* The mqtt client struct */
static struct mqtt_client client;

/* MQTT Broker details. */
static struct sockaddr_storage broker;

/* Connected flag */
static bool connected;

/* File descriptor */
static struct pollfd fds;

/* Structures for work */
static struct k_delayed_work leds_update_work;
static struct k_work connect_work;

/* Sensor data */
static struct gps_nmea gps_nmea_data;
static struct nrf_cloud_sensor_data gps_cloud_data = {
	.type = NRF_CLOUD_SENSOR_GPS,
	.tag = 0x1,
	.data.ptr = gps_nmea_data.buf,
	.data.len = GPS_NMEA_SENTENCE_MAX_LENGTH,
};
static atomic_val_t send_data_enable;

#if defined(CONFIG_BSD_LIBRARY)

/**@brief Recoverable BSD library error. */
void bsd_recoverable_error_handler(uint32_t err)
{
	printk("bsdlib recoverable error: %u\n", (unsigned int)err);
}

#endif /* defined(CONFIG_BSD_LIBRARY) */

#if defined(CONFIG_LWM2M_CARRIER)
K_SEM_DEFINE(carrier_registered, 0, 1);

void lwm2m_carrier_event_handler(const lwm2m_carrier_event_t *event)
{
	switch (event->type) {
	case LWM2M_CARRIER_EVENT_BSDLIB_INIT:
		printk("LWM2M_CARRIER_EVENT_BSDLIB_INIT\n");
		break;
	case LWM2M_CARRIER_EVENT_CONNECT:
		printk("LWM2M_CARRIER_EVENT_CONNECT\n");
		break;
	case LWM2M_CARRIER_EVENT_DISCONNECT:
		printk("LWM2M_CARRIER_EVENT_DISCONNECT\n");
		break;
	case LWM2M_CARRIER_EVENT_READY:
		printk("LWM2M_CARRIER_EVENT_READY\n");
		k_sem_give(&carrier_registered);
		break;
	case LWM2M_CARRIER_EVENT_FOTA_START:
		printk("LWM2M_CARRIER_EVENT_FOTA_START\n");
		break;
	case LWM2M_CARRIER_EVENT_REBOOT:
		printk("LWM2M_CARRIER_EVENT_REBOOT\n");
		break;
	}
}
#endif /* defined(CONFIG_LWM2M_CARRIER) */

/**@brief Function to print strings without null-termination
 */
static void data_print(u8_t *prefix, u8_t *data, size_t len)
{
	char buf[len + 1];

	memcpy(buf, data, len);
	buf[len] = 0;
	printk("%s%s\n", prefix, buf);
}

/**@brief Function to publish data on the configured topic
 */
static int data_publish(struct mqtt_client *c, enum mqtt_qos qos,
	u8_t *data, size_t len)
{
	struct mqtt_publish_param param;

	param.message.topic.qos = qos;
	param.message.topic.topic.utf8 = CONFIG_MQTT_PUB_TOPIC;
	param.message.topic.topic.size = strlen(CONFIG_MQTT_PUB_TOPIC);
	param.message.payload.data = data;
	param.message.payload.len = len;
	param.message_id = sys_rand32_get();
	param.dup_flag = 0;
	param.retain_flag = 0;

	data_print("Publishing: ", data, len);
	printk("to topic: %s len: %u\n",
		CONFIG_MQTT_PUB_TOPIC,
		(unsigned int)strlen(CONFIG_MQTT_PUB_TOPIC));

	return mqtt_publish(c, &param);
}

/**@brief Function to subscribe to the configured topic
 */
static int subscribe(void)
{
	struct mqtt_topic subscribe_topic = {
		.topic = {
			.utf8 = CONFIG_MQTT_SUB_TOPIC,
			.size = strlen(CONFIG_MQTT_SUB_TOPIC)
		},
		.qos = MQTT_QOS_1_AT_LEAST_ONCE
	};

	const struct mqtt_subscription_list subscription_list = {
		.list = &subscribe_topic,
		.list_count = 1,
		.message_id = 1234
	};

	printk("Subscribing to: %s len %u\n", CONFIG_MQTT_SUB_TOPIC,
		(unsigned int)strlen(CONFIG_MQTT_SUB_TOPIC));

	return mqtt_subscribe(&client, &subscription_list);
}

/**@brief Function to read the published payload.
 */
static int publish_get_payload(struct mqtt_client *c, size_t length)
{
	u8_t *buf = payload_buf;
	u8_t *end = buf + length;

	if (length > sizeof(payload_buf)) {
		return -EMSGSIZE;
	}

	while (buf < end) {
		int ret = mqtt_read_publish_payload(c, buf, end - buf);

		if (ret < 0) {
			int err;

			if (ret != -EAGAIN) {
				return ret;
			}

			printk("mqtt_read_publish_payload: EAGAIN\n");

			err = poll(&fds, 1,
				   CONFIG_MQTT_KEEPALIVE * MSEC_PER_SEC);
			if (err > 0 && (fds.revents & POLLIN) == POLLIN) {
				continue;
			} else {
				return -EIO;
			}
		}

		if (ret == 0) {
			return -EIO;
		}

		buf += ret;
	}

	return 0;
}

/**@brief MQTT client event handler
 */
void mqtt_evt_handler(struct mqtt_client *const c,
		      const struct mqtt_evt *evt)
{
	int err;

	switch (evt->type) {
	case MQTT_EVT_CONNACK:
		if (evt->result != 0) {
			printk("MQTT connect failed %d\n", evt->result);
			break;
		}
                display_state = LEDS_CLOUD_CONNECTED;
		connected = true;
		printk("[%s:%d] MQTT client connected!\n", __func__, __LINE__);
		// subscribe();
		break;

	case MQTT_EVT_DISCONNECT:
		printk("[%s:%d] MQTT client disconnected %d\n", __func__,
		       __LINE__, evt->result);

                display_state = LEDS_CLOUD_CONNECTING;
		connected = false;
                // Retry connect
                k_work_submit(&connect_work);
		break;

	case MQTT_EVT_PUBLISH: {
		const struct mqtt_publish_param *p = &evt->param.publish;

		printk("[%s:%d] MQTT PUBLISH result=%d len=%d\n", __func__,
		       __LINE__, evt->result, p->message.payload.len);
		err = publish_get_payload(c, p->message.payload.len);
		if (err >= 0) {
			data_print("Received: ", payload_buf,
				p->message.payload.len);
			/* Echo back received data */
			// data_publish(&client, MQTT_QOS_1_AT_LEAST_ONCE,
			//	payload_buf, p->message.payload.len);
		} else {
			printk("mqtt_read_publish_payload: Failed! %d\n", err);
			printk("Disconnecting MQTT client...\n");

			err = mqtt_disconnect(c);
			if (err) {
				printk("Could not disconnect: %d\n", err);
			}
		}
	} break;

	case MQTT_EVT_PUBACK:
		if (evt->result != 0) {
			printk("MQTT PUBACK error %d\n", evt->result);
			break;
		}

		printk("[%s:%d] PUBACK packet id: %u\n", __func__, __LINE__,
				evt->param.puback.message_id);
		break;

	case MQTT_EVT_SUBACK:
		if (evt->result != 0) {
			printk("MQTT SUBACK error %d\n", evt->result);
			break;
		}

		printk("[%s:%d] SUBACK packet id: %u\n", __func__, __LINE__,
				evt->param.suback.message_id);
		break;

	default:
		printk("[%s:%d] default: %d\n", __func__, __LINE__,
				evt->type);
		break;
	}
}

/**@brief Resolves the configured hostname and
 * initializes the MQTT broker structure
 */
static void broker_init(void)
{
	int err;
	struct addrinfo *result;
	struct addrinfo *addr;
	struct addrinfo hints = {
		.ai_family = AF_INET,
		.ai_socktype = SOCK_STREAM
	};

	err = getaddrinfo(CONFIG_MQTT_BROKER_HOSTNAME, NULL, &hints, &result);
	if (err) {
		printk("ERROR: getaddrinfo failed %d\n", err);

		return;
	}

	addr = result;
	err = -ENOENT;

	/* Look for address of the broker. */
	while (addr != NULL) {
		/* IPv4 Address. */
		if (addr->ai_addrlen == sizeof(struct sockaddr_in)) {
			struct sockaddr_in *broker4 =
				((struct sockaddr_in *)&broker);
			char ipv4_addr[NET_IPV4_ADDR_LEN];

			broker4->sin_addr.s_addr =
				((struct sockaddr_in *)addr->ai_addr)
				->sin_addr.s_addr;
			broker4->sin_family = AF_INET;
			broker4->sin_port = htons(CONFIG_MQTT_BROKER_PORT);

			inet_ntop(AF_INET, &broker4->sin_addr.s_addr,
				  ipv4_addr, sizeof(ipv4_addr));
			printk("IPv4 Address found %s\n", ipv4_addr);

			break;
		} else {
			printk("ai_addrlen = %u should be %u or %u\n",
				(unsigned int)addr->ai_addrlen,
				(unsigned int)sizeof(struct sockaddr_in),
				(unsigned int)sizeof(struct sockaddr_in6));
		}

		addr = addr->ai_next;
		break;
	}

	/* Free the address. */
	freeaddrinfo(result);
}

/**@brief Initialize the MQTT client structure
 */
static void client_init(struct mqtt_client *client)
{
	mqtt_client_init(client);

	broker_init();

        struct mqtt_utf8 password;
        password.utf8 = (u8_t *)CONFIG_MQTT_CLIENT_PASSWORD;
        password.size = strlen(CONFIG_MQTT_CLIENT_PASSWORD);

        struct mqtt_utf8 username;
        username.utf8 = (u8_t *)CONFIG_MQTT_CLIENT_USERNAME;
        username.size = strlen(CONFIG_MQTT_CLIENT_USERNAME);

	/* MQTT client configuration */
	client->broker = &broker;
	client->evt_cb = mqtt_evt_handler;
	client->client_id.utf8 = CONFIG_MQTT_CLIENT_ID;
	client->client_id.size = strlen(CONFIG_MQTT_CLIENT_ID);
        client->password = &password;
        client->user_name = &username;
	client->protocol_version = MQTT_VERSION_3_1_0;
        
        printk("PASSWORD: %s\n", client->password->utf8);
	printk("USERNAME: %s\n", client->user_name->utf8);

	/* MQTT buffers configuration */
	client->rx_buf = rx_buffer;
	client->rx_buf_size = sizeof(rx_buffer);
	client->tx_buf = tx_buffer;
	client->tx_buf_size = sizeof(tx_buffer);

	/* MQTT transport configuration */
	client->transport.type = MQTT_TRANSPORT_NON_SECURE;
}

/**@brief Initialize the file descriptor structure used by poll.
 */
static int fds_init(struct mqtt_client *c)
{
	if (c->transport.type == MQTT_TRANSPORT_NON_SECURE) {
		fds.fd = c->transport.tcp.sock;
	} else {
#if defined(CONFIG_MQTT_LIB_TLS)
		fds.fd = c->transport.tls.sock;
#else
		return -ENOTSUP;
#endif
	}

	fds.events = POLLIN;

	return 0;
}

static void init_file_descriptor(void)
{       
        int err;
	err = fds_init(&client);
	if (err != 0) {
		printk("ERROR: fds_init %d\n", err);
		return;
	}
}

/**@brief Configures modem to provide LTE link. Blocks until link is
 * successfully established.
 */
static void modem_configure(void)
{
#if defined(CONFIG_LTE_LINK_CONTROL)
	if (IS_ENABLED(CONFIG_LTE_AUTO_INIT_AND_CONNECT)) {
		/* Do nothing, modem is already turned on
		 * and connected.
		 */
                 display_state = LEDS_LTE_CONNECTED;
	} else {
#if defined(CONFIG_LWM2M_CARRIER)
		/* Wait for the LWM2M_CARRIER to configure the modem and
		 * start the connection.
		 */
		printk("Waitng for carrier registration...\n");
		k_sem_take(&carrier_registered, K_FOREVER);
		printk("Registered!\n");
#else /* defined(CONFIG_LWM2M_CARRIER) */
		int err;
                display_state = LEDS_LTE_CONNECTING;
		printk("LTE Link Connecting ...\n");
		err = lte_lc_init_and_connect();
		__ASSERT(err == 0, "LTE link could not be established.");
		printk("LTE Link Connected!\n");
                display_state = LEDS_LTE_CONNECTED;
#endif /* defined(CONFIG_LWM2M_CARRIER) */
	}
#endif /* defined(CONFIG_LTE_LINK_CONTROL) */
}

/**@brief Update LEDs state. */
static void leds_update(struct k_work *work)
{
	static bool led_on;
	static u8_t current_led_on_mask;
	u8_t led_on_mask = current_led_on_mask;

	ARG_UNUSED(work);

	/* Reset LED3 and LED4. */
	led_on_mask &= ~(DK_LED3_MSK | DK_LED4_MSK);

	/* Set LED3 and LED4 to match current state. */
	led_on_mask |= LED_GET_ON(display_state);

	led_on = !led_on;
	if (led_on) {
		led_on_mask |= LED_GET_BLINK(display_state);
	} else {
		led_on_mask &= ~LED_GET_BLINK(display_state);
	}

	if (led_on_mask != current_led_on_mask) {
		dk_set_leds(led_on_mask);
		current_led_on_mask = led_on_mask;
	}

	k_delayed_work_submit(&leds_update_work, LEDS_UPDATE_INTERVAL);
}

/**@brief Callback for button events from the DK buttons and LEDs library. */
static void button_handler(u32_t buttons, u32_t has_changed)
{
	printk("button_handler: button 1: %u, button 2: %u "
	       "switch 1: %u, switch 2: %u\n",
	       (bool)(buttons & BUTTON_1), (bool)(buttons & BUTTON_2),
	       (bool)(buttons & SWITCH_1), (bool)(buttons & SWITCH_2));
}

/**@brief Initializes buttons and LEDs, using the DK buttons and LEDs
 * library.
 */
static void buttons_leds_init(void)
{
	int err;

	err = dk_buttons_init(button_handler);
	if (err) {
		printk("Could not initialize buttons, err code: %d\n", err);
	}

	err = dk_leds_init();
	if (err) {
		printk("Could not initialize leds, err code: %d\n", err);
	}

	err = dk_set_leds_state(0x00, DK_ALL_LEDS_MSK);
	if (err) {
		printk("Could not set leds state, err code: %d\n", err);
	}
}

/**@brief Connect to nRF Cloud, */
static void connect_mqtt(struct k_work *work)
{
        int err;
        err = mqtt_connect(&client);
	if (err != 0) {
		printk("ERROR: mqtt_connect %d\n", err);
		return;
	}
}

/**@brief Callback for GPS events */
static void gps_handler(struct device *dev, struct gps_event *evt)
{
	u32_t button_state, has_changed;
	struct sensor_data in_data = {
		.type = GPS_POSITION,
		.length = evt->nmea.len,
	};

	ARG_UNUSED(dev);

	switch (evt->type) {
	case GPS_EVT_SEARCH_STARTED:
		printk("GPS_EVT_SEARCH_STARTED\n");
		return;
	case GPS_EVT_SEARCH_STOPPED:
		printk("GPS_EVT_SEARCH_STOPPED\n");
		return;
	case GPS_EVT_SEARCH_TIMEOUT:
		printk("GPS_EVT_SEARCH_TIMEOUT\n");
		return;
	case GPS_EVT_PVT_FIX:
		printk("GPS_EVT_PVT_FIX\n");
		return;
	case GPS_EVT_NMEA_FIX:
		printk("GPS_EVT_NMEA_FIX\n");
		break;
	default:
		return;
	}

	dk_read_buttons(&button_state, &has_changed);

	if ((button_state & SWITCH_2) || !atomic_get(&send_data_enable)) {
                printk("NOGPS\n");
		return;
	}

	gps_cloud_data.tag++;

	if (gps_cloud_data.tag == 0) {
		gps_cloud_data.tag = 0x1;
	}

	memcpy(&in_data.data[0], &gps_cloud_data.tag,
		sizeof(gps_cloud_data.tag));

	memcpy(&in_data.data[sizeof(gps_cloud_data.tag)],
		evt->nmea.buf, evt->nmea.len);

	if (aggregator_put(in_data) != 0) {
		printk("Failed to store GPS data.\n");
	}
}

/**@brief Initializes the sensors that are used by the application. */
static void sensors_init(void)
{
	int err;
	struct device *gps_dev = device_get_binding(CONFIG_GPS_DEV_NAME);
	struct gps_config gps_cfg = {
		.nav_mode = GPS_NAV_MODE_PERIODIC,
		.interval = CONFIG_GPS_SEARCH_INTERVAL,
		.timeout = CONFIG_GPS_SEARCH_TIMEOUT,
	};

	if (gps_dev == NULL) {
		printk("Could not get %s device\n", CONFIG_GPS_DEV_NAME);
		return;
	}

	err = gps_init(gps_dev, gps_handler);
	if (err) {
		printk("Could not initialize GPS, error: %d\n", err);
		return;
	}

	printk("GPS initialized\n");

	err = gps_start(gps_dev, &gps_cfg);
	if (err) {
		printk("Failed to start GPS, error: %d\n", err);
		return;
	}

	printk("GPS started with interval %d seconds, and timeout %d seconds\n",
	       CONFIG_GPS_SEARCH_INTERVAL, CONFIG_GPS_SEARCH_TIMEOUT);
}

/**@brief Initializes and submits delayed work. */
static void work_init(void)
{
	k_delayed_work_init(&leds_update_work, leds_update);
        k_work_init(&connect_work, connect_mqtt);
        k_delayed_work_submit(&leds_update_work, LEDS_UPDATE_INTERVAL);
}

void main(void)
{
	int err;

        buttons_leds_init();
        work_init();

        display_state = LEDS_INITIALIZING;

	modem_configure();
	client_init(&client);
        connect_mqtt(NULL);
        init_file_descriptor();
        ble_init();
//        sensors_init();
//        atomic_set(&send_data_enable, 1);

	while (1) {
//                printk("HERE1\n");
		err = poll(&fds, 1, mqtt_keepalive_time_left(&client));
//                err = poll(&fds, 1, 5000);
		if (err < 0) {
			printk("ERROR: poll %d\n", errno);
			break;
		}
		err = mqtt_live(&client);
		if ((err != 0) && (err != -EAGAIN)) {
			printk("ERROR: mqtt_live %d\n", err);
			break;
		}
		if ((fds.revents & POLLIN) == POLLIN) {
			err = mqtt_input(&client);
			if (err != 0) {
				printk("ERROR: mqtt_input %d\n", err);
				break;
			}
		}
		if ((fds.revents & POLLERR) == POLLERR) {
			printk("POLLERR\n");
			break;
		}
		if ((fds.revents & POLLNVAL) == POLLNVAL) {
			printk("POLLNVAL\n");
			break;
		}
                send_aggregated_data(&client, MQTT_QOS_1_AT_LEAST_ONCE);
                k_sleep(K_MSEC(10));
		k_cpu_idle();
	}

	printk("Disconnecting MQTT client...\n");
        display_state = LEDS_CLOUD_CONNECTING;
	err = mqtt_disconnect(&client);
	if (err) {
		printk("Could not disconnect MQTT client. Error: %d\n", err);
	}
}
```

## src/aggregator.c
```c
/*
 * Copyright (c) 2018 Nordic Semiconductor ASA
 *
 * SPDX-License-Identifier: LicenseRef-BSD-5-Clause-Nordic
 */
#include "aggregator.h"
#include <kernel.h>
#include <zephyr.h>
#include <stdio.h>
#include <zephyr/types.h>
#include <string.h>
#include <irq.h>

K_FIFO_DEFINE(aggregator_fifo);

static u32_t entry_count;

struct fifo_entry {
	void *fifo_reserved;
	u8_t data[ENTRY_MAX_SIZE];
};

int aggregator_put(struct sensor_data in_data)
{
	struct fifo_entry *fifo_data = NULL;
	u32_t  lock = irq_lock();
	int    err  = 0;

//        printk("PUTTING [%s] INTO AGG\n", in_data.data);

//        printk("AGGREGATOR PUT INFO:\nentry_count: %d\nFIFO_MAX_ELEMENT_COUNT: %d\n", entry_count, FIFO_MAX_ELEMENT_COUNT);
	if (entry_count == FIFO_MAX_ELEMENT_COUNT) {
		fifo_data = k_fifo_get(&aggregator_fifo, K_NO_WAIT);

		__ASSERT(fifo_data != NULL, "fifo_data should not be NULL");

		entry_count--;
	}

	if (fifo_data == NULL) {
		fifo_data = k_malloc(sizeof(struct fifo_entry));
	}

	if (fifo_data == NULL) {
		err = -ENOMEM;
		goto exit;
	}

	memcpy(fifo_data->data, &in_data, sizeof(struct sensor_data));

	k_fifo_put(&aggregator_fifo, fifo_data);
	entry_count++;

exit:
	irq_unlock(lock);
	return err;
}

int aggregator_get(struct sensor_data *out_data)
{
	void  *fifo_data;
	int   err = 0;

//        printk("AGGREGATOR GET INFO:\nentry_count: %d\nFIFO_MAX_ELEMENT_COUNT: %d\n", entry_count, FIFO_MAX_ELEMENT_COUNT);

	if (out_data == NULL) {
		return -EINVAL;
	}

	u32_t lock = irq_lock();

	fifo_data = k_fifo_get(&aggregator_fifo, K_NO_WAIT);
	if (fifo_data == NULL) {
		err = -ENODATA;
		goto exit;
	}

	memcpy(out_data, ((struct fifo_entry *)fifo_data)->data,
	       sizeof(struct sensor_data));

	k_free(fifo_data);
	entry_count--;

exit:
	irq_unlock(lock);
	return err;
}

void aggregator_clear(void)
{
	void *fifo_data;
	u32_t lock = irq_lock();

	while (1) {
		fifo_data = k_fifo_get(&aggregator_fifo, K_NO_WAIT);

		if (fifo_data == NULL) {
			break;
		}

		k_free(fifo_data);
	};

	entry_count = 0;
	irq_unlock(lock);
}

int aggregator_element_count_get(void)
{
	return entry_count;
}
```

## src/aggregator.h
```c
/*
 * Copyright (c) 2018 Nordic Semiconductor ASA
 *
 * SPDX-License-Identifier: LicenseRef-BSD-5-Clause-Nordic
 */

#ifndef _AGGREGATOR_H_
#define _AGGREGATOR_H_

/*
 * Simple aggregator module which can have sensordata added and retrieved in a
 * FIFO fashion. The queue allows TLD formated data to be aggregated from
 * sensors in a FIFO fashion. When some event in the future causes data
 * transfer to start, the most recent X datapoints (determined by ENTRY_MAX_SIZE
 * and HEAP_MEM_POOL_SIZE) can be transferred.
 *
 * Note: The module is single instance to allow simple global access to the
 * data.
 */
#include <zephyr/types.h>
#include <drivers/gps.h>

/* In this sample the GPS data is 83 byte + a data sequence tag,
 * so 87 byte is used.
 */
#define ENTRY_MAX_SIZE (GPS_NMEA_SENTENCE_MAX_LENGTH + 4)
#define FIFO_MAX_ELEMENT_COUNT 128

enum sensor_data_type { BEACON_ID, GPS_POSITION };

struct sensor_data {
	u8_t length;
	enum sensor_data_type type;
	u8_t data[ENTRY_MAX_SIZE];
};

int aggregator_init(void);

int aggregator_put(struct sensor_data data);

int aggregator_get(struct sensor_data *data);

void aggregator_clear(void);

int aggregator_element_count_get(void);

#endif /* _AGGREGATOR_H_ */
```

## src/alarm.c
```c
/*
 * Copyright (c) 2018 Nordic Semiconductor ASA
 *
 * SPDX-License-Identifier: LicenseRef-BSD-5-Clause-Nordic
 */
#include <string.h>
#include <stdbool.h>
#include <sys/printk.h>
#include <net/mqtt.h>
#include <net/nrf_cloud.h>

#include "alarm.h"

#include "aggregator.h"

/**@brief Function to print strings without null-termination
 */
static void data_print(u8_t *prefix, u8_t *data, size_t len)
{
	char buf[len + 1];

	memcpy(buf, data, len);
	buf[len] = 0;
	printk("%s%s\n", prefix, buf);
}

void send_aggregated_data(struct mqtt_client *c, enum mqtt_qos qos)
{
	static u8_t gps_data_buffer[GPS_NMEA_SENTENCE_MAX_LENGTH];

	static struct nrf_cloud_sensor_data gps_cloud_data = {
		.type = NRF_CLOUD_SENSOR_GPS,
		.data.ptr = gps_data_buffer,
	};

	struct sensor_data aggregator_data;

        struct mqtt_publish_param param;

	param.message.topic.qos = qos;
	param.message.topic.topic.utf8 = CONFIG_MQTT_PUB_TOPIC;
	param.message.topic.topic.size = strlen(CONFIG_MQTT_PUB_TOPIC);
	param.message_id = sys_rand32_get();
	param.dup_flag = 0;
	param.retain_flag = 0;

//	printk("Send data triggered!\n");
	while (1) {
		if (aggregator_get(&aggregator_data) == -ENODATA) {
			break;
		}
		switch (aggregator_data.type) {
		case BEACON_ID:
                        printk("ALARM SEND\n");
//			printk("[%d] Sending Device data.\n",
//			       aggregator_element_count_get());
//			if (aggregator_data.length != 1 ||
//				aggregator_data.data[0] >=
//				ARRAY_SIZE(orientation_strings)) {
//				printk("Unexpected FLIP data format, dropping\n");
//				continue;
//			}
//			flip_cloud_data.data.ptr =
//				orientation_strings[aggregator_data.data[0]];
//			flip_cloud_data.data.len = strlen(
//				orientation_strings[aggregator_data.data[0]]) - 1;
                        param.message.payload.data = aggregator_data.data;
                        param.message.payload.len = aggregator_data.length;
                        data_print("Publishing: ", aggregator_data.data, aggregator_data.length);
//                        printk("to topic: %s len: %u\n",CONFIG_MQTT_PUB_TOPIC, (unsigned int)strlen(CONFIG_MQTT_PUB_TOPIC));
			mqtt_publish(c, &param);
			break;

		case GPS_POSITION:
			printk("%d] Sending GPS data.\n",
			       aggregator_element_count_get());
			gps_cloud_data.data.ptr = &aggregator_data.data[4];
			gps_cloud_data.data.len = aggregator_data.length;
			gps_cloud_data.tag =
			    *((u32_t *)&aggregator_data.data[0]);
                        param.message.payload.data = gps_cloud_data.data.ptr;
                        param.message.payload.len = gps_cloud_data.data.len;
                        data_print("Publishing: ", aggregator_data.data, aggregator_data.length);
                        printk("to topic: %s len: %u\n",CONFIG_MQTT_PUB_TOPIC, (unsigned int)strlen(CONFIG_MQTT_PUB_TOPIC));
			mqtt_publish(c, &param);
			break;

		default:
			printk("Unsupported data type from aggregator: %d.\n",
			       aggregator_data.type);
			continue;
		}
	}
}
```

## src/alarm.h
```c
/*
 * Copyright (c) 2018 Nordic Semiconductor ASA
 *
 * SPDX-License-Identifier: LicenseRef-BSD-5-Clause-Nordic
 */

#ifndef _ALARM_H_
#define _ALARM_H_

void send_aggregated_data(struct mqtt_client *c, enum mqtt_qos qos);

#endif /* _ALARM_H_ */
```

## src/ble.c
```c
/*
 * Copyright (c) 2018 Nordic Semiconductor ASA
 *
 * SPDX-License-Identifier: LicenseRef-BSD-5-Clause-Nordic
 */

#include <zephyr.h>
#include <bluetooth/conn.h>

#include <bluetooth/gatt.h>
#include <bluetooth/uuid.h>
#include <bluetooth/gatt_dm.h>
#include <bluetooth/scan.h>

#include <dk_buttons_and_leds.h>
#include <sys/byteorder.h>

#include <net/nrf_cloud.h>
#include "aggregator.h"

#define BT_UUID_BEACON                                                            \
	BT_UUID_DECLARE_16(0xfeaa)

#define BEACON_UUID_START 4
#define BEACON_UUID_SIZE 16

extern void alarm(void);

/**@brief Function to print strings without null-termination
 */
static void data_print(u8_t *prefix, u8_t *data, size_t len)
{
	char buf[len + 1];

	memcpy(buf, data, len);
	buf[len] = 0;
	printk("%s%s\n", prefix, buf);
}

static void insert_data(const void *data, u8_t len)
{
        // data_print("DEVICE NAME: ", data, len);
        char data_arr[len];
        strcpy(data_arr, data);
        struct sensor_data in_data;

        in_data.type = BEACON_ID;
        in_data.length = len;
//        in_data.data[0] = ((u8_t *)data)[0];
        memcpy(in_data.data, data_arr, len);

        if (aggregator_put(in_data) != 0) {
                printk("Was not able to insert device name data into aggregator.\n");
        }
        printk("AGGREGATOR COUNT: %d\n",aggregator_element_count_get());
//          /* If the thingy is upside down, trigger an alarm. */
//          if (((u8_t *)data)[0] == 3) {
//                  alarm();
//          }
}

static bool adv_data_found(struct bt_data *data, void *user_data)
{
        int i;
        if (data->type == BT_DATA_UUID16_ALL) {
//              printk("Direct advertising received from %s\n", (char *)user_data);
//              printk("--------------\n");
              for (i=0; i < data->data_len; i++) {
//                  printk("%x", data->data[i]);
              }
//              printk("\n");
              insert_data(user_data, strlen((char *)user_data));
        }
        if (data->type == BT_DATA_SVC_DATA16) {
//              printk("--------------\n");
              for (i=0; i < data->data_len; i++) {
//                  printk("%x", data->data[i]);
              }
//              printk("\n");
        }
        if (data->type == BT_DATA_NAME_COMPLETE) {
//              printk("--------------\n");
              for (i=0; i < data->data_len; i++) {
//                  printk("%c", data->data[i]);
              }
//              printk("\n");
        }
//	if(data->type== BT_DATA_MANUFACTURER_DATA) {
//           printk("--------------\n");
//           printk("Manuf. data: ");
//	   for(i=0; i < data->data_len; i++){
//                printk("%x, ", data->data[i]);
//           }
//           printk("\n");
//           printk("Beacon uuid: ");
//           for(i=0; i < BEACON_UUID_SIZE; i++){
//                index = i + BEACON_UUID_START;
//                beacon_uuid[i] = (uint8_t)data->data[index];
//                printk("%x,", data->data[index]);
//           }
//           printk("\n");
//
//           printk("Beacon major: ");
//           for(i=0; i < BEACON_MAJOR_SIZE; i++){
//                index = i + BEACON_MAJOR_START;
//                beacon_major[i] = (uint8_t)data->data[index];
//                printk("%x,", data->data[index]);
//           }
//           printk("\n");
//            printk("Beacon minor: ");
//           for(i=0; i < BEACON_MINOR_SIZE; i++){
//                index = i + BEACON_MINOR_START;
//                beacon_minor[i] = (uint8_t)data->data[index];
//                printk("%x,", data->data[index]);
//           }
//           printk("\n\n");
//	   return false;
//	}


	return true;
}

static void scan_cb(const bt_addr_le_t *addr, s8_t rssi, u8_t adv_type,
		    struct net_buf_simple *ad)
{
//        printk("scan callback\n");
	char addr_str[BT_ADDR_LE_STR_LEN];
        bt_addr_le_to_str(addr, addr_str, sizeof(addr_str));
//        printk("Direct advertising received from %s\n", addr_str);
        bt_data_parse(ad, adv_data_found, addr_str);
}

//BT_SCAN_CB_INIT(scan_cb, scan_filter_match, scan_filter_no_match, scan_connecting_error, NULL);

static void scan_start(void)
{
	int err;
//
	struct bt_le_scan_param scan_param = {
		.type = BT_HCI_LE_SCAN_PASSIVE,
		.filter_dup = BT_HCI_LE_SCAN_FILTER_DUP_DISABLE,
		.interval = 0x3E80, // SCAN EVERY ms
		.window = 0x0030, // FOR THIS MANY ms
	};
//
	struct bt_scan_init_param scan_init = {
//		.connect_if_match = 1,
		.scan_param = &scan_param
//		.conn_param = BT_LE_CONN_PARAM_DEFAULT,
	};
//
	bt_scan_init(&scan_init);
//	bt_scan_cb_register(&scan_cb);
//
////        struct bt_scan_short_name device_name;
////        const char *device_name = "Nordic Discovery Sample";
//
//	err = bt_scan_filter_add(BT_SCAN_FILTER_TYPE_UUID, BT_UUID_BEACON);
//	if (err) {
//		printk("Scanning filters cannot be set\n");
//		return;
//	}
//
//	err = bt_scan_filter_enable(BT_SCAN_UUID_FILTER, false);
//	if (err) {
//		printk("Filters cannot be turned on\n");
//	}

	err = bt_le_scan_start(&scan_param, scan_cb);
	if (err) {
		printk("Scanning failed to start, err %d\n", err);
	}

	printk("Scanning...\n");
}

static void ble_ready(int err)
{
	printk("Bluetooth ready\n");

	// bt_conn_cb_register(&conn_callbacks);
	scan_start();
}

void ble_init(void)
{
	int err;

	printk("Initializing Bluetooth..\n");
	err = bt_enable(ble_ready);
	if (err) {
		printk("Bluetooth init failed (err %d)\n", err);
		return;
	}
}
```
